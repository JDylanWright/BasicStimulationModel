/******************************************************************************
* ASAP2 file: SimpleStim.a2l
* Academic License - for use in teaching, academic research, and meeting
* course requirements at degree granting institutions only. Not for
* government, commercial, or other organizational use.
* Code generation for model "SimpleStim".
* Model version : 1.7
* Simulink Coder version : 10.2 R2020b
* C source code generated on : Thu Mar 31 18:34:37 2022
* Target selection: slrealtime.tlc
* Embedded hardware selection: Intel->x86-64 (Linux 64)
* Code generation objectives: Unspecified
* Validation result: Not run
* (add additional file header information here)
******************************************************************************/ ASAP2_VERSION 1 71
/begin PROJECT ProjectName "Project Comment Goes Here"
/begin HEADER "Header Comments go here" /end HEADER
/begin MODULE ModuleName "Module Comment Goes Here"
/begin IF_DATA XCP
 /begin PROTOCOL_LAYER 0x0100 0x03E8 0x00C8 0x0000 0x0000 0x0000 0x0000 0x0000 0xFC 0x0578 BYTE_ORDER_MSB_LAST ADDRESS_GRANULARITY_BYTE OPTIONAL_CMD ALLOC_ODT_ENTRY OPTIONAL_CMD ALLOC_ODT OPTIONAL_CMD ALLOC_DAQ OPTIONAL_CMD FREE_DAQ OPTIONAL_CMD GET_DAQ_RESOLUTION_INFO OPTIONAL_CMD GET_DAQ_PROCESSOR_INFO OPTIONAL_CMD START_STOP_SYNCH OPTIONAL_CMD START_STOP_DAQ_LIST OPTIONAL_CMD SET_DAQ_LIST_MODE OPTIONAL_CMD WRITE_DAQ OPTIONAL_CMD SET_DAQ_PTR OPTIONAL_CMD GET_CAL_PAGE OPTIONAL_CMD SET_CAL_PAGE OPTIONAL_CMD COPY_CAL_PAGE OPTIONAL_CMD SHORT_DOWNLOAD OPTIONAL_CMD DOWNLOAD_MAX OPTIONAL_CMD DOWNLOAD OPTIONAL_CMD SHORT_UPLOAD OPTIONAL_CMD UPLOAD OPTIONAL_CMD SET_MTA /end PROTOCOL_LAYER
 /begin DAQ DYNAMIC 0x0000 0x0080 0x00 OPTIMISATION_TYPE_DEFAULT ADDRESS_EXTENSION_FREE IDENTIFICATION_FIELD_TYPE_RELATIVE_WORD_ALIGNED GRANULARITY_ODT_ENTRY_SIZE_DAQ_BYTE 0xFF OVERLOAD_INDICATION_PID PRESCALER_SUPPORTED /begin STIM GRANULARITY_ODT_ENTRY_SIZE_STIM_BYTE 0xFF /end STIM /begin TIMESTAMP_SUPPORTED 0x0001 SIZE_DWORD UNIT_1US TIMESTAMP_FIXED /end TIMESTAMP_SUPPORTED /begin EVENT "1 ms" "1 ms" 0x0000 DAQ 0xFF 0x01 0x06 0x00 /end EVENT /end DAQ
 /begin XCP_ON_UDP_IP 0x0100 0x15B3 ADDRESS "192.168.7.5" /end XCP_ON_UDP_IP
/end IF_DATA
/begin MOD_PAR "MOD PAR Comment Goes Here"
 /begin MEMORY_SEGMENT SimpleStim_cal_impl "SimpleStim_cal_impl" DATA FLASH INTERN 0x00212020 0x388 -1 -1 -1 -1 -1
  /begin IF_DATA XCP
   /begin SEGMENT 0x00 0x02 0x00 0x00 0x00
    /begin PAGE 0x00 ECU_ACCESS_DONT_CARE XCP_READ_ACCESS_DONT_CARE XCP_WRITE_ACCESS_NOT_ALLOWED /end PAGE
    /begin PAGE 0x01 ECU_ACCESS_DONT_CARE XCP_READ_ACCESS_DONT_CARE XCP_WRITE_ACCESS_DONT_CARE /end PAGE
   /end SEGMENT
  /end IF_DATA
 /end MEMORY_SEGMENT
/end MOD_PAR
/begin MOD_COMMON "Mod Common Comment Here" BYTE_ORDER MSB_LAST /end MOD_COMMON
/begin CHARACTERISTIC SimpleStim_cal_impl.BeepState_Value "" VALUE 0x002122E8 Scalar_FLOAT64_IEEE 0 SimpleStim_CM_double -1.7E+308 1.7E+308 /end CHARACTERISTIC
/begin CHARACTERISTIC SimpleStim_cal_impl.Constant1_Value "" VAL_BLK 0x00212188 Scalar_FLOAT64_IEEE 0 SimpleStim_CM_double -1.7E+308 1.7E+308 MATRIX_DIM 18 1 /end CHARACTERISTIC
/begin CHARACTERISTIC SimpleStim_cal_impl.Constant1_Value_n "" VALUE 0x0021236E Scalar_UBYTE 0 SimpleStim_CM_uint8 0 255 /end CHARACTERISTIC
/begin CHARACTERISTIC SimpleStim_cal_impl.Constant2_Value "" VALUE 0x00212310 Scalar_UWORD 0 SimpleStim_CM_uint16 0 65535 /end CHARACTERISTIC
/begin CHARACTERISTIC SimpleStim_cal_impl.Constant3_Value "" VAL_BLK 0x0021232E Scalar_UBYTE 0 SimpleStim_CM_uint8 0 255 MATRIX_DIM 39 1 /end CHARACTERISTIC
/begin CHARACTERISTIC SimpleStim_cal_impl.Constant_Value "" VAL_BLK 0x002120E0 Scalar_FLOAT64_IEEE 0 SimpleStim_CM_double -1.7E+308 1.7E+308 MATRIX_DIM 21 1 /end CHARACTERISTIC
/begin CHARACTERISTIC SimpleStim_cal_impl.Constant_Value_f "" VALUE 0x0021236D Scalar_UBYTE 0 SimpleStim_CM_uint8 0 255 /end CHARACTERISTIC
/begin CHARACTERISTIC SimpleStim_cal_impl.HighPALimMemory_InitialValue "" VALUE 0x002122F0 Scalar_FLOAT64_IEEE 0 SimpleStim_CM_double -1.7E+308 1.7E+308 /end CHARACTERISTIC
/begin CHARACTERISTIC SimpleStim_cal_impl.HighPWLimMemory_InitialValue "" VALUE 0x0021236F Scalar_UBYTE 0 SimpleStim_CM_uint8 0 255 /end CHARACTERISTIC
/begin CHARACTERISTIC SimpleStim_cal_impl.LowPALimMemory_InitialValue "" VALUE 0x002122F8 Scalar_FLOAT64_IEEE 0 SimpleStim_CM_double -1.7E+308 1.7E+308 /end CHARACTERISTIC
/begin CHARACTERISTIC SimpleStim_cal_impl.LowPWLimMemory_InitialValue "" VALUE 0x00212370 Scalar_UBYTE 0 SimpleStim_CM_uint8 0 255 /end CHARACTERISTIC
/begin CHARACTERISTIC SimpleStim_cal_impl.snp_PAMemory_InitialValue "" VAL_BLK 0x00212218 Scalar_FLOAT64_IEEE 0 SimpleStim_CM_double -1.7E+308 1.7E+308 MATRIX_DIM 24 1 /end CHARACTERISTIC
/begin CHARACTERISTIC SimpleStim_cal_impl.stim_CHMemory_InitialValue "" VAL_BLK 0x00212389 Scalar_BOOLEAN 0 SimpleStim_CM_logical 0 1 MATRIX_DIM 24 1 /end CHARACTERISTIC
/begin CHARACTERISTIC SimpleStim_cal_impl.stim_CH_in_Value "" VAL_BLK 0x00212371 Scalar_BOOLEAN 0 SimpleStim_CM_logical 0 1 MATRIX_DIM 24 1 /end CHARACTERISTIC
/begin CHARACTERISTIC SimpleStim_cal_impl.stim_IPIMemory_InitialValue "" VALUE 0x00212314 Scalar_UWORD 0 SimpleStim_CM_uint16 0 65535 /end CHARACTERISTIC
/begin CHARACTERISTIC SimpleStim_cal_impl.stim_IPI_in_Value "" VALUE 0x00212312 Scalar_UWORD 0 SimpleStim_CM_uint16 0 65535 /end CHARACTERISTIC
/begin CHARACTERISTIC SimpleStim_cal_impl.stim_PA_in_Value "" VAL_BLK 0x00212020 Scalar_FLOAT64_IEEE 0 SimpleStim_CM_double -1.7E+308 1.7E+308 MATRIX_DIM 24 1 /end CHARACTERISTIC
/begin CHARACTERISTIC SimpleStim_cal_impl.stim_PWMemory_InitialValue "" VAL_BLK 0x00212355 Scalar_UBYTE 0 SimpleStim_CM_uint8 0 255 MATRIX_DIM 24 1 /end CHARACTERISTIC
/begin CHARACTERISTIC SimpleStim_cal_impl.stim_PW_in_Value "" VAL_BLK 0x00212316 Scalar_UBYTE 0 SimpleStim_CM_uint8 0 255 MATRIX_DIM 24 1 /end CHARACTERISTIC
/begin CHARACTERISTIC SimpleStim_cal_impl.trial_delayMemory_InitialValue "" VALUE 0x00212300 Scalar_FLOAT64_IEEE 0 SimpleStim_CM_double -1.7E+308 1.7E+308 /end CHARACTERISTIC
/begin CHARACTERISTIC SimpleStim_cal_impl.trial_delay_in_Value "" VALUE 0x002122D8 Scalar_FLOAT64_IEEE 0 SimpleStim_CM_double -1.7E+308 1.7E+308 /end CHARACTERISTIC
/begin CHARACTERISTIC SimpleStim_cal_impl.trial_stopMemory_InitialValue "" VALUE 0x00212308 Scalar_FLOAT64_IEEE 0 SimpleStim_CM_double -1.7E+308 1.7E+308 /end CHARACTERISTIC
/begin CHARACTERISTIC SimpleStim_cal_impl.trial_stop_in_Value "" VALUE 0x002122E0 Scalar_FLOAT64_IEEE 0 SimpleStim_CM_double -1.7E+308 1.7E+308 /end CHARACTERISTIC
/begin MEASUREMENT SimpleStim_B.CheckLowerBound "" FLOAT64_IEEE SimpleStim_CM_double 0 0 -1.7E+308 1.7E+308 LAYOUT COLUMN_DIR MATRIX_DIM 24 ECU_ADDRESS 0x002128C0 /end MEASUREMENT
/begin MEASUREMENT SimpleStim_B.CheckLowerBound_h "" UBYTE SimpleStim_CM_uint8 0 0 0 255 LAYOUT COLUMN_DIR MATRIX_DIM 24 ECU_ADDRESS 0x00212B9C /end MEASUREMENT
/begin MEASUREMENT SimpleStim_B.CheckUpperBound "" FLOAT64_IEEE SimpleStim_CM_double 0 0 -1.7E+308 1.7E+308 LAYOUT COLUMN_DIR MATRIX_DIM 24 ECU_ADDRESS 0x00212980 /end MEASUREMENT
/begin MEASUREMENT SimpleStim_B.CheckUpperBound_k "" UBYTE SimpleStim_CM_uint8 0 0 0 255 LAYOUT COLUMN_DIR MATRIX_DIM 24 ECU_ADDRESS 0x00212BB4 /end MEASUREMENT
/begin MEASUREMENT SimpleStim_B.DataStoreRead "" FLOAT64_IEEE SimpleStim_CM_double 0 0 -1.7E+308 1.7E+308 ECU_ADDRESS 0x002127F0 /end MEASUREMENT
/begin MEASUREMENT SimpleStim_B.DataStoreRead1 "" FLOAT64_IEEE SimpleStim_CM_double 0 0 -1.7E+308 1.7E+308 ECU_ADDRESS 0x002127E8 /end MEASUREMENT
/begin MEASUREMENT SimpleStim_B.DataStoreRead2 "" FLOAT64_IEEE SimpleStim_CM_double 0 0 -1.7E+308 1.7E+308 ECU_ADDRESS 0x00212B78 /end MEASUREMENT
/begin MEASUREMENT SimpleStim_B.DataStoreRead_f "" UBYTE SimpleStim_CM_uint8 0 0 0 255 ECU_ADDRESS 0x00212B82 /end MEASUREMENT
/begin MEASUREMENT SimpleStim_B.DigitalClock "" FLOAT64_IEEE SimpleStim_CM_double 0 0 -1.7E+308 1.7E+308 ECU_ADDRESS 0x002127E0 /end MEASUREMENT
/begin MEASUREMENT SimpleStim_B.GreaterThan "" UBYTE SimpleStim_CM_logical 0 0 0 1 LAYOUT COLUMN_DIR MATRIX_DIM 24 ECU_ADDRESS 0x00212C16 /end MEASUREMENT
/begin MEASUREMENT SimpleStim_B.GreaterThan1 "" UBYTE SimpleStim_CM_logical 0 0 0 1 ECU_ADDRESS 0x00212C14 /end MEASUREMENT
/begin MEASUREMENT SimpleStim_B.GreaterThan_m "" UBYTE SimpleStim_CM_logical 0 0 0 1 LAYOUT COLUMN_DIR MATRIX_DIM 24 ECU_ADDRESS 0x00212C5E /end MEASUREMENT
/begin MEASUREMENT SimpleStim_B.LessThanOrEqual "" UBYTE SimpleStim_CM_logical 0 0 0 1 LAYOUT COLUMN_DIR MATRIX_DIM 24 ECU_ADDRESS 0x00212C2E /end MEASUREMENT
/begin MEASUREMENT SimpleStim_B.LessThanOrEqual_m "" UBYTE SimpleStim_CM_logical 0 0 0 1 LAYOUT COLUMN_DIR MATRIX_DIM 24 ECU_ADDRESS 0x00212C76 /end MEASUREMENT
/begin MEASUREMENT SimpleStim_B.LogicalOperator "" UBYTE SimpleStim_CM_logical 0 0 0 1 ECU_ADDRESS 0x00212C15 /end MEASUREMENT
/begin MEASUREMENT SimpleStim_B.LookupTableDynamic "" UBYTE SimpleStim_CM_uint8 0 0 0 255 LAYOUT COLUMN_DIR MATRIX_DIM 24 ECU_ADDRESS 0x00212BE4 /end MEASUREMENT
/begin MEASUREMENT SimpleStim_B.PAStimOnOff "" UBYTE SimpleStim_CM_uint8 0 0 0 255 LAYOUT COLUMN_DIR MATRIX_DIM 24 ECU_ADDRESS 0x00212BFC /end MEASUREMENT
/begin MEASUREMENT SimpleStim_B.PWStimOnOff "" UBYTE SimpleStim_CM_uint8 0 0 0 255 LAYOUT COLUMN_DIR MATRIX_DIM 24 ECU_ADDRESS 0x00212BCC /end MEASUREMENT
/begin MEASUREMENT SimpleStim_B.StimPWRead "" UBYTE SimpleStim_CM_uint8 0 0 0 255 LAYOUT COLUMN_DIR MATRIX_DIM 24 ECU_ADDRESS 0x00212B83 /end MEASUREMENT
/begin MEASUREMENT SimpleStim_B.TimeCheck "" UBYTE SimpleStim_CM_logical 0 0 0 1 ECU_ADDRESS 0x00212C8E /end MEASUREMENT
/begin MEASUREMENT SimpleStim_B.TmpSignalConversionAtLookupTabl "" FLOAT64_IEEE SimpleStim_CM_double 0 0 -1.7E+308 1.7E+308 LAYOUT COLUMN_DIR MATRIX_DIM 39 ECU_ADDRESS 0x00212A40 /end MEASUREMENT
/begin MEASUREMENT SimpleStim_B.sf_set_delays.delay "" UWORD SimpleStim_CM_uint16 0 0 0 65535 LAYOUT COLUMN_DIR MATRIX_DIM 12 ECU_ADDRESS 0x00212CA8 /end MEASUREMENT
/begin MEASUREMENT SimpleStim_B.sf_set_delays1.delay "" UWORD SimpleStim_CM_uint16 0 0 0 65535 LAYOUT COLUMN_DIR MATRIX_DIM 12 ECU_ADDRESS 0x00212C90 /end MEASUREMENT
/begin MEASUREMENT SimpleStim_B.stim_CHRead "" UBYTE SimpleStim_CM_logical 0 0 0 1 LAYOUT COLUMN_DIR MATRIX_DIM 24 ECU_ADDRESS 0x00212C46 /end MEASUREMENT
/begin MEASUREMENT SimpleStim_B.stim_IPI "" UWORD SimpleStim_CM_uint16 0 0 0 65535 ECU_ADDRESS 0x00212B80 /end MEASUREMENT
/begin MEASUREMENT SimpleStim_B.stim_PARead "" FLOAT64_IEEE SimpleStim_CM_double 0 0 -1.7E+308 1.7E+308 LAYOUT COLUMN_DIR MATRIX_DIM 24 ECU_ADDRESS 0x002127F8 /end MEASUREMENT
/begin MEASUREMENT SimpleStim_B.u "" FLOAT64_IEEE SimpleStim_CM_double 0 0 -1.7E+308 1.7E+308 ECU_ADDRESS 0x002128B8 /end MEASUREMENT
/begin MEASUREMENT SimpleStim_B.u_f "" UBYTE SimpleStim_CM_uint8 0 0 0 255 ECU_ADDRESS 0x00212B9B /end MEASUREMENT
/begin MEASUREMENT SimpleStim_DW.Beep_SubsysRanBC "" SBYTE SimpleStim_CM_int8 0 0 -128 127 ECU_ADDRESS 0x00212734 /end MEASUREMENT
/begin MEASUREMENT SimpleStim_DW.Beep_SubsysRanBC_h "" SBYTE SimpleStim_CM_int8 0 0 -128 127 ECU_ADDRESS 0x00212735 /end MEASUREMENT
/begin MEASUREMENT SimpleStim_DW.HighPALim "" FLOAT64_IEEE SimpleStim_CM_double 0 0 -1.7E+308 1.7E+308 ECU_ADDRESS 0x00212620 /end MEASUREMENT
/begin MEASUREMENT SimpleStim_DW.HighPWLim "" UBYTE SimpleStim_CM_uint8 0 0 0 255 ECU_ADDRESS 0x0021277E /end MEASUREMENT
/begin MEASUREMENT SimpleStim_DW.LowPALim "" FLOAT64_IEEE SimpleStim_CM_double 0 0 -1.7E+308 1.7E+308 ECU_ADDRESS 0x00212628 /end MEASUREMENT
/begin MEASUREMENT SimpleStim_DW.LowPWLim "" UBYTE SimpleStim_CM_uint8 0 0 0 255 ECU_ADDRESS 0x0021277F /end MEASUREMENT
/begin MEASUREMENT SimpleStim_DW.Schedule_Duration "" UWORD SimpleStim_CM_uint16 0 0 0 65535 ECU_ADDRESS 0x00212730 /end MEASUREMENT
/begin MEASUREMENT SimpleStim_DW.Stim1_Amp "" UBYTE SimpleStim_CM_uint8 0 0 0 255 LAYOUT COLUMN_DIR MATRIX_DIM 12 ECU_ADDRESS 0x00212772 /end MEASUREMENT
/begin MEASUREMENT SimpleStim_DW.Stim1_Created "" UBYTE SimpleStim_CM_logical 0 0 0 1 LAYOUT COLUMN_DIR MATRIX_DIM 12 ECU_ADDRESS 0x002127A4 /end MEASUREMENT
/begin MEASUREMENT SimpleStim_DW.Stim1_Delay "" UWORD SimpleStim_CM_uint16 0 0 0 65535 LAYOUT COLUMN_DIR MATRIX_DIM 12 ECU_ADDRESS 0x00212718 /end MEASUREMENT
/begin MEASUREMENT SimpleStim_DW.Stim1_EventID "" UBYTE SimpleStim_CM_uint8 0 0 0 255 LAYOUT COLUMN_DIR MATRIX_DIM 12 ECU_ADDRESS 0x0021275A /end MEASUREMENT
/begin MEASUREMENT SimpleStim_DW.Stim1_PW "" UBYTE SimpleStim_CM_uint8 0 0 0 255 LAYOUT COLUMN_DIR MATRIX_DIM 12 ECU_ADDRESS 0x00212766 /end MEASUREMENT
/begin MEASUREMENT SimpleStim_DW.Stim_Amp "" UBYTE SimpleStim_CM_uint8 0 0 0 255 LAYOUT COLUMN_DIR MATRIX_DIM 12 ECU_ADDRESS 0x0021274E /end MEASUREMENT
/begin MEASUREMENT SimpleStim_DW.Stim_Created "" UBYTE SimpleStim_CM_logical 0 0 0 1 LAYOUT COLUMN_DIR MATRIX_DIM 12 ECU_ADDRESS 0x00212798 /end MEASUREMENT
/begin MEASUREMENT SimpleStim_DW.Stim_Delay "" UWORD SimpleStim_CM_uint16 0 0 0 65535 LAYOUT COLUMN_DIR MATRIX_DIM 12 ECU_ADDRESS 0x00212700 /end MEASUREMENT
/begin MEASUREMENT SimpleStim_DW.Stim_EventID "" UBYTE SimpleStim_CM_uint8 0 0 0 255 LAYOUT COLUMN_DIR MATRIX_DIM 12 ECU_ADDRESS 0x00212736 /end MEASUREMENT
/begin MEASUREMENT SimpleStim_DW.Stim_PW "" UBYTE SimpleStim_CM_uint8 0 0 0 255 LAYOUT COLUMN_DIR MATRIX_DIM 12 ECU_ADDRESS 0x00212742 /end MEASUREMENT
/begin MEASUREMENT SimpleStim_DW.stim_CH "" UBYTE SimpleStim_CM_logical 0 0 0 1 LAYOUT COLUMN_DIR MATRIX_DIM 24 ECU_ADDRESS 0x002127B0 /end MEASUREMENT
/begin MEASUREMENT SimpleStim_DW.stim_IPI "" UWORD SimpleStim_CM_uint16 0 0 0 65535 ECU_ADDRESS 0x00212732 /end MEASUREMENT
/begin MEASUREMENT SimpleStim_DW.stim_PA "" FLOAT64_IEEE SimpleStim_CM_double 0 0 -1.7E+308 1.7E+308 LAYOUT COLUMN_DIR MATRIX_DIM 24 ECU_ADDRESS 0x00212630 /end MEASUREMENT
/begin MEASUREMENT SimpleStim_DW.stim_PW "" UBYTE SimpleStim_CM_uint8 0 0 0 255 LAYOUT COLUMN_DIR MATRIX_DIM 24 ECU_ADDRESS 0x00212780 /end MEASUREMENT
/begin MEASUREMENT SimpleStim_DW.trial_delay "" FLOAT64_IEEE SimpleStim_CM_double 0 0 -1.7E+308 1.7E+308 ECU_ADDRESS 0x002126F0 /end MEASUREMENT
/begin MEASUREMENT SimpleStim_DW.trial_stop "" FLOAT64_IEEE SimpleStim_CM_double 0 0 -1.7E+308 1.7E+308 ECU_ADDRESS 0x002126F8 /end MEASUREMENT
/begin MEASUREMENT SimpleStim_PrevZCX.Beep_Trig_ZCE "" UBYTE SimpleStim_CM_ZCSigState 0 0 0 255 ECU_ADDRESS 0x00212610 /end MEASUREMENT
/begin COMPU_METHOD SimpleStim_CM_ZCSigState "" IDENTICAL "customformat" "" /end COMPU_METHOD
/begin COMPU_METHOD SimpleStim_CM_double "" IDENTICAL "%15.10" "" /end COMPU_METHOD
/begin COMPU_METHOD SimpleStim_CM_int8 "" IDENTICAL "%3.0" "" /end COMPU_METHOD
/begin COMPU_METHOD SimpleStim_CM_logical "" IDENTICAL "%1.0" "" /end COMPU_METHOD
/begin COMPU_METHOD SimpleStim_CM_uint16 "" IDENTICAL "%5.0" "" /end COMPU_METHOD
/begin COMPU_METHOD SimpleStim_CM_uint8 "" IDENTICAL "%3.0" "" /end COMPU_METHOD
/begin RECORD_LAYOUT Scalar_BOOLEAN FNC_VALUES 1 UBYTE COLUMN_DIR DIRECT /end RECORD_LAYOUT
/begin RECORD_LAYOUT Scalar_FLOAT64_IEEE FNC_VALUES 1 FLOAT64_IEEE COLUMN_DIR DIRECT /end RECORD_LAYOUT
/begin RECORD_LAYOUT Scalar_SBYTE FNC_VALUES 1 SBYTE COLUMN_DIR DIRECT /end RECORD_LAYOUT
/begin RECORD_LAYOUT Scalar_UBYTE FNC_VALUES 1 UBYTE COLUMN_DIR DIRECT /end RECORD_LAYOUT
/begin RECORD_LAYOUT Scalar_UWORD FNC_VALUES 1 UWORD COLUMN_DIR DIRECT /end RECORD_LAYOUT
/begin GROUP SimpleStim "SimpleStim" ROOT /end GROUP
/end MODULE
/end PROJECT
