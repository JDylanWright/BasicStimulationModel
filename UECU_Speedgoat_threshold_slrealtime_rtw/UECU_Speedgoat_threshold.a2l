/******************************************************************************
* ASAP2 file: UECU_Speedgoat_threshold.a2l
* Academic License - for use in teaching, academic research, and meeting
* course requirements at degree granting institutions only. Not for
* government, commercial, or other organizational use.
* Code generation for model "UECU_Speedgoat_threshold".
* Model version : 21.61
* Simulink Coder version : 10.2 R2020b
* C source code generated on : Fri Apr 15 16:52:50 2022
* Target selection: slrealtime.tlc
* Embedded hardware selection: Intel->x86-64 (Linux 64)
* Code generation objectives: Unspecified
* Validation result: Not run
* (add additional file header information here)
******************************************************************************/ ASAP2_VERSION 1 71
/begin PROJECT ProjectName "Project Comment Goes Here"
/begin HEADER "Header Comments go here" /end HEADER
/begin MODULE ModuleName "Module Comment Goes Here"
/begin IF_DATA XCP
 /begin PROTOCOL_LAYER 0x0100 0x03E8 0x00C8 0x0000 0x0000 0x0000 0x0000 0x0000 0xFC 0x0578 BYTE_ORDER_MSB_LAST ADDRESS_GRANULARITY_BYTE OPTIONAL_CMD ALLOC_ODT_ENTRY OPTIONAL_CMD ALLOC_ODT OPTIONAL_CMD ALLOC_DAQ OPTIONAL_CMD FREE_DAQ OPTIONAL_CMD GET_DAQ_RESOLUTION_INFO OPTIONAL_CMD GET_DAQ_PROCESSOR_INFO OPTIONAL_CMD START_STOP_SYNCH OPTIONAL_CMD START_STOP_DAQ_LIST OPTIONAL_CMD SET_DAQ_LIST_MODE OPTIONAL_CMD WRITE_DAQ OPTIONAL_CMD SET_DAQ_PTR OPTIONAL_CMD GET_CAL_PAGE OPTIONAL_CMD SET_CAL_PAGE OPTIONAL_CMD COPY_CAL_PAGE OPTIONAL_CMD SHORT_DOWNLOAD OPTIONAL_CMD DOWNLOAD_MAX OPTIONAL_CMD DOWNLOAD OPTIONAL_CMD SHORT_UPLOAD OPTIONAL_CMD UPLOAD OPTIONAL_CMD SET_MTA /end PROTOCOL_LAYER
 /begin DAQ DYNAMIC 0x0000 0x0080 0x00 OPTIMISATION_TYPE_DEFAULT ADDRESS_EXTENSION_FREE IDENTIFICATION_FIELD_TYPE_RELATIVE_WORD_ALIGNED GRANULARITY_ODT_ENTRY_SIZE_DAQ_BYTE 0xFF OVERLOAD_INDICATION_PID PRESCALER_SUPPORTED /begin STIM GRANULARITY_ODT_ENTRY_SIZE_STIM_BYTE 0xFF /end STIM /begin TIMESTAMP_SUPPORTED 0x0001 SIZE_DWORD UNIT_1US TIMESTAMP_FIXED /end TIMESTAMP_SUPPORTED /begin EVENT "1 ms" "1 ms" 0x0000 DAQ 0xFF 0x01 0x06 0x00 /end EVENT /end DAQ
 /begin XCP_ON_UDP_IP 0x0100 0x15B3 ADDRESS "192.168.7.5" /end XCP_ON_UDP_IP
/end IF_DATA
/begin MOD_PAR "MOD PAR Comment Goes Here"
 /begin MEMORY_SEGMENT UECU_Speedgoat_thresho_cal_impl "UECU_Speedgoat_thresho_cal_impl" DATA FLASH INTERN 0x00212020 0x380 -1 -1 -1 -1 -1
  /begin IF_DATA XCP
   /begin SEGMENT 0x00 0x02 0x00 0x00 0x00
    /begin PAGE 0x00 ECU_ACCESS_DONT_CARE XCP_READ_ACCESS_DONT_CARE XCP_WRITE_ACCESS_NOT_ALLOWED /end PAGE
    /begin PAGE 0x01 ECU_ACCESS_DONT_CARE XCP_READ_ACCESS_DONT_CARE XCP_WRITE_ACCESS_DONT_CARE /end PAGE
   /end SEGMENT
  /end IF_DATA
 /end MEMORY_SEGMENT
/end MOD_PAR
/begin MOD_COMMON "Mod Common Comment Here" BYTE_ORDER MSB_LAST /end MOD_COMMON
/begin CHARACTERISTIC UECU_Speedgoat_thresho_cal_impl.Constant1_Value "" VAL_BLK 0x00212020 Scalar_FLOAT64_IEEE 0 UECU_Speedgoat_threshold_CM_double -1.7E+308 1.7E+308 MATRIX_DIM 21 1 /end CHARACTERISTIC
/begin CHARACTERISTIC UECU_Speedgoat_thresho_cal_impl.Constant1_Value_l "" VALUE 0x00212366 Scalar_UBYTE 0 UECU_Speedgoat_threshold_CM_uint8 0 255 /end CHARACTERISTIC
/begin CHARACTERISTIC UECU_Speedgoat_thresho_cal_impl.Constant2_Value "" VAL_BLK 0x002120C8 Scalar_FLOAT64_IEEE 0 UECU_Speedgoat_threshold_CM_double -1.7E+308 1.7E+308 MATRIX_DIM 18 1 /end CHARACTERISTIC
/begin CHARACTERISTIC UECU_Speedgoat_thresho_cal_impl.Constant2_Value_n "" VALUE 0x00212308 Scalar_UWORD 0 UECU_Speedgoat_threshold_CM_uint16 0 65535 /end CHARACTERISTIC
/begin CHARACTERISTIC UECU_Speedgoat_thresho_cal_impl.Constant3_Value "" VAL_BLK 0x0021230E Scalar_UBYTE 0 UECU_Speedgoat_threshold_CM_uint8 0 255 MATRIX_DIM 39 1 /end CHARACTERISTIC
/begin CHARACTERISTIC UECU_Speedgoat_thresho_cal_impl.Constant_Value "" VALUE 0x00212365 Scalar_UBYTE 0 UECU_Speedgoat_threshold_CM_uint8 0 255 /end CHARACTERISTIC
/begin CHARACTERISTIC UECU_Speedgoat_thresho_cal_impl.EnableBeep_Value "" VALUE 0x00212399 Scalar_BOOLEAN 0 UECU_Speedgoat_threshold_CM_logical 0 1 /end CHARACTERISTIC
/begin CHARACTERISTIC UECU_Speedgoat_thresho_cal_impl.HighPALimMemory_InitialValue "" VALUE 0x002122E8 Scalar_FLOAT64_IEEE 0 UECU_Speedgoat_threshold_CM_double -1.7E+308 1.7E+308 /end CHARACTERISTIC
/begin CHARACTERISTIC UECU_Speedgoat_thresho_cal_impl.HighPWLimMemory_InitialValue "" VALUE 0x00212367 Scalar_UBYTE 0 UECU_Speedgoat_threshold_CM_uint8 0 255 /end CHARACTERISTIC
/begin CHARACTERISTIC UECU_Speedgoat_thresho_cal_impl.LowPALimMemory_InitialValue "" VALUE 0x002122F0 Scalar_FLOAT64_IEEE 0 UECU_Speedgoat_threshold_CM_double -1.7E+308 1.7E+308 /end CHARACTERISTIC
/begin CHARACTERISTIC UECU_Speedgoat_thresho_cal_impl.LowPWLimMemory_InitialValue "" VALUE 0x00212368 Scalar_UBYTE 0 UECU_Speedgoat_threshold_CM_uint8 0 255 /end CHARACTERISTIC
/begin CHARACTERISTIC UECU_Speedgoat_thresho_cal_impl.snp_CHMemory_InitialValue "" VAL_BLK 0x00212381 Scalar_BOOLEAN 0 UECU_Speedgoat_threshold_CM_logical 0 1 MATRIX_DIM 24 1 /end CHARACTERISTIC
/begin CHARACTERISTIC UECU_Speedgoat_thresho_cal_impl.snp_CH_in_Value "" VAL_BLK 0x00212369 Scalar_BOOLEAN 0 UECU_Speedgoat_threshold_CM_logical 0 1 MATRIX_DIM 24 1 /end CHARACTERISTIC
/begin CHARACTERISTIC UECU_Speedgoat_thresho_cal_impl.snp_IPIMemory_InitialValue "" VALUE 0x0021230C Scalar_UWORD 0 UECU_Speedgoat_threshold_CM_uint16 0 65535 /end CHARACTERISTIC
/begin CHARACTERISTIC UECU_Speedgoat_thresho_cal_impl.snp_IPI_in_Value "" VALUE 0x0021230A Scalar_UWORD 0 UECU_Speedgoat_threshold_CM_uint16 0 65535 /end CHARACTERISTIC
/begin CHARACTERISTIC UECU_Speedgoat_thresho_cal_impl.snp_PAMemory_InitialValue "" VAL_BLK 0x00212218 Scalar_FLOAT64_IEEE 0 UECU_Speedgoat_threshold_CM_double -1.7E+308 1.7E+308 MATRIX_DIM 24 1 /end CHARACTERISTIC
/begin CHARACTERISTIC UECU_Speedgoat_thresho_cal_impl.snp_PA_in_Value "" VAL_BLK 0x00212158 Scalar_FLOAT64_IEEE 0 UECU_Speedgoat_threshold_CM_double -1.7E+308 1.7E+308 MATRIX_DIM 24 1 /end CHARACTERISTIC
/begin CHARACTERISTIC UECU_Speedgoat_thresho_cal_impl.snp_PWMemory_InitialValue "" VAL_BLK 0x0021234D Scalar_UBYTE 0 UECU_Speedgoat_threshold_CM_uint8 0 255 MATRIX_DIM 24 1 /end CHARACTERISTIC
/begin CHARACTERISTIC UECU_Speedgoat_thresho_cal_impl.snp_PW_in_Value "" VAL_BLK 0x00212335 Scalar_UBYTE 0 UECU_Speedgoat_threshold_CM_uint8 0 255 MATRIX_DIM 24 1 /end CHARACTERISTIC
/begin CHARACTERISTIC UECU_Speedgoat_thresho_cal_impl.trial_delayMemory_InitialValue "" VALUE 0x002122F8 Scalar_FLOAT64_IEEE 0 UECU_Speedgoat_threshold_CM_double -1.7E+308 1.7E+308 /end CHARACTERISTIC
/begin CHARACTERISTIC UECU_Speedgoat_thresho_cal_impl.trial_delay_in_Value "" VALUE 0x002122D8 Scalar_FLOAT64_IEEE 0 UECU_Speedgoat_threshold_CM_double -1.7E+308 1.7E+308 /end CHARACTERISTIC
/begin CHARACTERISTIC UECU_Speedgoat_thresho_cal_impl.trial_stopMemory_InitialValue "" VALUE 0x00212300 Scalar_FLOAT64_IEEE 0 UECU_Speedgoat_threshold_CM_double -1.7E+308 1.7E+308 /end CHARACTERISTIC
/begin CHARACTERISTIC UECU_Speedgoat_thresho_cal_impl.trial_stop_in_Value "" VALUE 0x002122E0 Scalar_FLOAT64_IEEE 0 UECU_Speedgoat_threshold_CM_double -1.7E+308 1.7E+308 /end CHARACTERISTIC
/begin MEASUREMENT UECU_Speedgoat_threshol_PrevZCX.Beep_Trig_ZCE "" UBYTE UECU_Speedgoat_threshold_CM_ZCSigState 0 0 0 255 ECU_ADDRESS 0x00212610 /end MEASUREMENT
/begin MEASUREMENT UECU_Speedgoat_threshold_B.DataStoreRead1 "" FLOAT64_IEEE UECU_Speedgoat_threshold_CM_double 0 0 -1.7E+308 1.7E+308 ECU_ADDRESS 0x002127E8 /end MEASUREMENT
/begin MEASUREMENT UECU_Speedgoat_threshold_B.DataStoreRead12 "" FLOAT64_IEEE UECU_Speedgoat_threshold_CM_double 0 0 -1.7E+308 1.7E+308 ECU_ADDRESS 0x002128C0 /end MEASUREMENT
/begin MEASUREMENT UECU_Speedgoat_threshold_B.DataStoreRead12_j "" UBYTE UECU_Speedgoat_threshold_CM_uint8 0 0 0 255 ECU_ADDRESS 0x00212B9B /end MEASUREMENT
/begin MEASUREMENT UECU_Speedgoat_threshold_B.DataStoreRead13 "" FLOAT64_IEEE UECU_Speedgoat_threshold_CM_double 0 0 -1.7E+308 1.7E+308 ECU_ADDRESS 0x002127F8 /end MEASUREMENT
/begin MEASUREMENT UECU_Speedgoat_threshold_B.DataStoreRead13_k "" UBYTE UECU_Speedgoat_threshold_CM_uint8 0 0 0 255 ECU_ADDRESS 0x00212B82 /end MEASUREMENT
/begin MEASUREMENT UECU_Speedgoat_threshold_B.DataStoreRead2 "" FLOAT64_IEEE UECU_Speedgoat_threshold_CM_double 0 0 -1.7E+308 1.7E+308 ECU_ADDRESS 0x002127F0 /end MEASUREMENT
/begin MEASUREMENT UECU_Speedgoat_threshold_B.LogicalOperator "" UBYTE UECU_Speedgoat_threshold_CM_logical 0 0 0 1 ECU_ADDRESS 0x00212C15 /end MEASUREMENT
/begin MEASUREMENT UECU_Speedgoat_threshold_B.LookupTableDynamic "" UBYTE UECU_Speedgoat_threshold_CM_uint8 0 0 0 255 LAYOUT COLUMN_DIR MATRIX_DIM 24 ECU_ADDRESS 0x00212BE4 /end MEASUREMENT
/begin MEASUREMENT UECU_Speedgoat_threshold_B.PAStimOnOff "" UBYTE UECU_Speedgoat_threshold_CM_uint8 0 0 0 255 LAYOUT COLUMN_DIR MATRIX_DIM 24 ECU_ADDRESS 0x00212BFC /end MEASUREMENT
/begin MEASUREMENT UECU_Speedgoat_threshold_B.PWStimOnOff "" UBYTE UECU_Speedgoat_threshold_CM_uint8 0 0 0 255 LAYOUT COLUMN_DIR MATRIX_DIM 24 ECU_ADDRESS 0x00212BCC /end MEASUREMENT
/begin MEASUREMENT UECU_Speedgoat_threshold_B.RelationalOperator "" UBYTE UECU_Speedgoat_threshold_CM_logical 0 0 0 1 LAYOUT COLUMN_DIR MATRIX_DIM 24 ECU_ADDRESS 0x00212C17 /end MEASUREMENT
/begin MEASUREMENT UECU_Speedgoat_threshold_B.RelationalOperator1 "" UBYTE UECU_Speedgoat_threshold_CM_logical 0 0 0 1 ECU_ADDRESS 0x00212C14 /end MEASUREMENT
/begin MEASUREMENT UECU_Speedgoat_threshold_B.RelationalOperator1_a "" UBYTE UECU_Speedgoat_threshold_CM_logical 0 0 0 1 LAYOUT COLUMN_DIR MATRIX_DIM 24 ECU_ADDRESS 0x00212C2F /end MEASUREMENT
/begin MEASUREMENT UECU_Speedgoat_threshold_B.RelationalOperator1_m "" UBYTE UECU_Speedgoat_threshold_CM_logical 0 0 0 1 LAYOUT COLUMN_DIR MATRIX_DIM 24 ECU_ADDRESS 0x00212C77 /end MEASUREMENT
/begin MEASUREMENT UECU_Speedgoat_threshold_B.RelationalOperator2 "" UBYTE UECU_Speedgoat_threshold_CM_logical 0 0 0 1 ECU_ADDRESS 0x00212C16 /end MEASUREMENT
/begin MEASUREMENT UECU_Speedgoat_threshold_B.RelationalOperator_i "" UBYTE UECU_Speedgoat_threshold_CM_logical 0 0 0 1 LAYOUT COLUMN_DIR MATRIX_DIM 24 ECU_ADDRESS 0x00212C5F /end MEASUREMENT
/begin MEASUREMENT UECU_Speedgoat_threshold_B.Switch "" FLOAT64_IEEE UECU_Speedgoat_threshold_CM_double 0 0 -1.7E+308 1.7E+308 LAYOUT COLUMN_DIR MATRIX_DIM 24 ECU_ADDRESS 0x002128C8 /end MEASUREMENT
/begin MEASUREMENT UECU_Speedgoat_threshold_B.Switch1 "" FLOAT64_IEEE UECU_Speedgoat_threshold_CM_double 0 0 -1.7E+308 1.7E+308 LAYOUT COLUMN_DIR MATRIX_DIM 24 ECU_ADDRESS 0x00212988 /end MEASUREMENT
/begin MEASUREMENT UECU_Speedgoat_threshold_B.Switch1_a "" UBYTE UECU_Speedgoat_threshold_CM_uint8 0 0 0 255 LAYOUT COLUMN_DIR MATRIX_DIM 24 ECU_ADDRESS 0x00212BB4 /end MEASUREMENT
/begin MEASUREMENT UECU_Speedgoat_threshold_B.Switch_b "" UBYTE UECU_Speedgoat_threshold_CM_uint8 0 0 0 255 LAYOUT COLUMN_DIR MATRIX_DIM 24 ECU_ADDRESS 0x00212B9C /end MEASUREMENT
/begin MEASUREMENT UECU_Speedgoat_threshold_B.TimeNow "" FLOAT64_IEEE UECU_Speedgoat_threshold_CM_double 0 0 -1.7E+308 1.7E+308 ECU_ADDRESS 0x002127E0 /end MEASUREMENT
/begin MEASUREMENT UECU_Speedgoat_threshold_B.TmpSignalConversionAtLookupTabl "" FLOAT64_IEEE UECU_Speedgoat_threshold_CM_double 0 0 -1.7E+308 1.7E+308 LAYOUT COLUMN_DIR MATRIX_DIM 39 ECU_ADDRESS 0x00212A48 /end MEASUREMENT
/begin MEASUREMENT UECU_Speedgoat_threshold_B.sf_set_delays.delay "" UWORD UECU_Speedgoat_threshold_CM_uint16 0 0 0 65535 LAYOUT COLUMN_DIR MATRIX_DIM 12 ECU_ADDRESS 0x00212CA8 /end MEASUREMENT
/begin MEASUREMENT UECU_Speedgoat_threshold_B.sf_set_delays1.delay "" UWORD UECU_Speedgoat_threshold_CM_uint16 0 0 0 65535 LAYOUT COLUMN_DIR MATRIX_DIM 12 ECU_ADDRESS 0x00212C90 /end MEASUREMENT
/begin MEASUREMENT UECU_Speedgoat_threshold_B.snp_CHRead "" UBYTE UECU_Speedgoat_threshold_CM_logical 0 0 0 1 LAYOUT COLUMN_DIR MATRIX_DIM 24 ECU_ADDRESS 0x00212C47 /end MEASUREMENT
/begin MEASUREMENT UECU_Speedgoat_threshold_B.snp_IPI "" UWORD UECU_Speedgoat_threshold_CM_uint16 0 0 0 65535 ECU_ADDRESS 0x00212B80 /end MEASUREMENT
/begin MEASUREMENT UECU_Speedgoat_threshold_B.snp_PARead "" FLOAT64_IEEE UECU_Speedgoat_threshold_CM_double 0 0 -1.7E+308 1.7E+308 LAYOUT COLUMN_DIR MATRIX_DIM 24 ECU_ADDRESS 0x00212800 /end MEASUREMENT
/begin MEASUREMENT UECU_Speedgoat_threshold_B.snp_PWRead "" UBYTE UECU_Speedgoat_threshold_CM_uint8 0 0 0 255 LAYOUT COLUMN_DIR MATRIX_DIM 24 ECU_ADDRESS 0x00212B83 /end MEASUREMENT
/begin MEASUREMENT UECU_Speedgoat_threshold_DW.Beep_SubsysRanBC "" SBYTE UECU_Speedgoat_threshold_CM_int8 0 0 -128 127 ECU_ADDRESS 0x00212734 /end MEASUREMENT
/begin MEASUREMENT UECU_Speedgoat_threshold_DW.Beep_SubsysRanBC_a "" SBYTE UECU_Speedgoat_threshold_CM_int8 0 0 -128 127 ECU_ADDRESS 0x00212735 /end MEASUREMENT
/begin MEASUREMENT UECU_Speedgoat_threshold_DW.HighPALim "" FLOAT64_IEEE UECU_Speedgoat_threshold_CM_double 0 0 -1.7E+308 1.7E+308 ECU_ADDRESS 0x00212620 /end MEASUREMENT
/begin MEASUREMENT UECU_Speedgoat_threshold_DW.HighPWLim "" UBYTE UECU_Speedgoat_threshold_CM_uint8 0 0 0 255 ECU_ADDRESS 0x00212736 /end MEASUREMENT
/begin MEASUREMENT UECU_Speedgoat_threshold_DW.LowPALim "" FLOAT64_IEEE UECU_Speedgoat_threshold_CM_double 0 0 -1.7E+308 1.7E+308 ECU_ADDRESS 0x00212628 /end MEASUREMENT
/begin MEASUREMENT UECU_Speedgoat_threshold_DW.LowPWLim "" UBYTE UECU_Speedgoat_threshold_CM_uint8 0 0 0 255 ECU_ADDRESS 0x00212737 /end MEASUREMENT
/begin MEASUREMENT UECU_Speedgoat_threshold_DW.Schedule_Duration "" UWORD UECU_Speedgoat_threshold_CM_uint16 0 0 0 65535 ECU_ADDRESS 0x00212700 /end MEASUREMENT
/begin MEASUREMENT UECU_Speedgoat_threshold_DW.Stim1_Amp "" UBYTE UECU_Speedgoat_threshold_CM_uint8 0 0 0 255 LAYOUT COLUMN_DIR MATRIX_DIM 12 ECU_ADDRESS 0x0021278C /end MEASUREMENT
/begin MEASUREMENT UECU_Speedgoat_threshold_DW.Stim1_Created "" UBYTE UECU_Speedgoat_threshold_CM_logical 0 0 0 1 LAYOUT COLUMN_DIR MATRIX_DIM 12 ECU_ADDRESS 0x002127BC /end MEASUREMENT
/begin MEASUREMENT UECU_Speedgoat_threshold_DW.Stim1_Delay "" UWORD UECU_Speedgoat_threshold_CM_uint16 0 0 0 65535 LAYOUT COLUMN_DIR MATRIX_DIM 12 ECU_ADDRESS 0x0021271C /end MEASUREMENT
/begin MEASUREMENT UECU_Speedgoat_threshold_DW.Stim1_EventID "" UBYTE UECU_Speedgoat_threshold_CM_uint8 0 0 0 255 LAYOUT COLUMN_DIR MATRIX_DIM 12 ECU_ADDRESS 0x00212774 /end MEASUREMENT
/begin MEASUREMENT UECU_Speedgoat_threshold_DW.Stim1_PW "" UBYTE UECU_Speedgoat_threshold_CM_uint8 0 0 0 255 LAYOUT COLUMN_DIR MATRIX_DIM 12 ECU_ADDRESS 0x00212780 /end MEASUREMENT
/begin MEASUREMENT UECU_Speedgoat_threshold_DW.Stim_Amp "" UBYTE UECU_Speedgoat_threshold_CM_uint8 0 0 0 255 LAYOUT COLUMN_DIR MATRIX_DIM 12 ECU_ADDRESS 0x00212768 /end MEASUREMENT
/begin MEASUREMENT UECU_Speedgoat_threshold_DW.Stim_Created "" UBYTE UECU_Speedgoat_threshold_CM_logical 0 0 0 1 LAYOUT COLUMN_DIR MATRIX_DIM 12 ECU_ADDRESS 0x002127B0 /end MEASUREMENT
/begin MEASUREMENT UECU_Speedgoat_threshold_DW.Stim_Delay "" UWORD UECU_Speedgoat_threshold_CM_uint16 0 0 0 65535 LAYOUT COLUMN_DIR MATRIX_DIM 12 ECU_ADDRESS 0x00212704 /end MEASUREMENT
/begin MEASUREMENT UECU_Speedgoat_threshold_DW.Stim_EventID "" UBYTE UECU_Speedgoat_threshold_CM_uint8 0 0 0 255 LAYOUT COLUMN_DIR MATRIX_DIM 12 ECU_ADDRESS 0x00212750 /end MEASUREMENT
/begin MEASUREMENT UECU_Speedgoat_threshold_DW.Stim_PW "" UBYTE UECU_Speedgoat_threshold_CM_uint8 0 0 0 255 LAYOUT COLUMN_DIR MATRIX_DIM 12 ECU_ADDRESS 0x0021275C /end MEASUREMENT
/begin MEASUREMENT UECU_Speedgoat_threshold_DW.snp_CH "" UBYTE UECU_Speedgoat_threshold_CM_logical 0 0 0 1 LAYOUT COLUMN_DIR MATRIX_DIM 24 ECU_ADDRESS 0x00212798 /end MEASUREMENT
/begin MEASUREMENT UECU_Speedgoat_threshold_DW.snp_IPI "" UWORD UECU_Speedgoat_threshold_CM_uint16 0 0 0 65535 ECU_ADDRESS 0x00212702 /end MEASUREMENT
/begin MEASUREMENT UECU_Speedgoat_threshold_DW.snp_PA "" FLOAT64_IEEE UECU_Speedgoat_threshold_CM_double 0 0 -1.7E+308 1.7E+308 LAYOUT COLUMN_DIR MATRIX_DIM 24 ECU_ADDRESS 0x00212630 /end MEASUREMENT
/begin MEASUREMENT UECU_Speedgoat_threshold_DW.snp_PW "" UBYTE UECU_Speedgoat_threshold_CM_uint8 0 0 0 255 LAYOUT COLUMN_DIR MATRIX_DIM 24 ECU_ADDRESS 0x00212738 /end MEASUREMENT
/begin MEASUREMENT UECU_Speedgoat_threshold_DW.trial_delay "" FLOAT64_IEEE UECU_Speedgoat_threshold_CM_double 0 0 -1.7E+308 1.7E+308 ECU_ADDRESS 0x002126F0 /end MEASUREMENT
/begin MEASUREMENT UECU_Speedgoat_threshold_DW.trial_stop "" FLOAT64_IEEE UECU_Speedgoat_threshold_CM_double 0 0 -1.7E+308 1.7E+308 ECU_ADDRESS 0x002126F8 /end MEASUREMENT
/begin COMPU_METHOD UECU_Speedgoat_threshold_CM_ZCSigState "" IDENTICAL "customformat" "" /end COMPU_METHOD
/begin COMPU_METHOD UECU_Speedgoat_threshold_CM_double "" IDENTICAL "%15.10" "" /end COMPU_METHOD
/begin COMPU_METHOD UECU_Speedgoat_threshold_CM_int8 "" IDENTICAL "%3.0" "" /end COMPU_METHOD
/begin COMPU_METHOD UECU_Speedgoat_threshold_CM_logical "" IDENTICAL "%1.0" "" /end COMPU_METHOD
/begin COMPU_METHOD UECU_Speedgoat_threshold_CM_uint16 "" IDENTICAL "%5.0" "" /end COMPU_METHOD
/begin COMPU_METHOD UECU_Speedgoat_threshold_CM_uint8 "" IDENTICAL "%3.0" "" /end COMPU_METHOD
/begin RECORD_LAYOUT Scalar_BOOLEAN FNC_VALUES 1 UBYTE COLUMN_DIR DIRECT /end RECORD_LAYOUT
/begin RECORD_LAYOUT Scalar_FLOAT64_IEEE FNC_VALUES 1 FLOAT64_IEEE COLUMN_DIR DIRECT /end RECORD_LAYOUT
/begin RECORD_LAYOUT Scalar_SBYTE FNC_VALUES 1 SBYTE COLUMN_DIR DIRECT /end RECORD_LAYOUT
/begin RECORD_LAYOUT Scalar_UBYTE FNC_VALUES 1 UBYTE COLUMN_DIR DIRECT /end RECORD_LAYOUT
/begin RECORD_LAYOUT Scalar_UWORD FNC_VALUES 1 UWORD COLUMN_DIR DIRECT /end RECORD_LAYOUT
/begin GROUP UECU_Speedgoat_threshold "UECU_Speedgoat_threshold" ROOT /end GROUP
/end MODULE
/end PROJECT
